## main/Kconfig.projbuild
```kconfig
menu "channelstv"

config CHANNELSTV_WIFI_SSID
    string "Wi-Fi network"
    default ""
    help
        Used only while the board has no network saved yet. Leave it empty to set one over the
        USB console instead ('W' ssid TAB password).

config CHANNELSTV_WIFI_PASSWORD
    string "Wi-Fi password"
    default ""

choice CHANNELSTV_H264_DECODER
    prompt "H.264 decoder"
    default CHANNELSTV_DEC_VIDEOJET
    help
        The software decoder for the video. Both decode constrained baseline, one access unit at a time.

config CHANNELSTV_DEC_ESP_H264
    bool "esp_h264 (Espressif's tinyH264 port)"

config CHANNELSTV_DEC_VIDEOJET
    bool "VideoJet (h264bsd with PIE SIMD kernels, components/videojet)"

endchoice

config CHANNELSTV_WIFI_OUTAGE_TEST
    bool "Test hook: pretend the saved Wi-Fi is down after the next start"
    default n
    help
        Adds GET /api/wifi/outage?s=N (Web control full): the board restarts and, for N seconds
        (30..900), doesn't try to join its saved network, as if the router were off. Its Wi-Fi
        settings stay as they are, and the next start after that is normal. For testing the setup
        hotspot that opens when the board hasn't joined two minutes after start. Not for releases.

endmenu
```

## sdkconfig.defaults
```kconfig
CONFIG_IDF_TARGET="esp32s3"
CONFIG_ESPTOOLPY_FLASHSIZE_16MB=y
CONFIG_ESPTOOLPY_FLASHMODE_QIO=y
CONFIG_ESP_CONSOLE_USB_SERIAL_JTAG=y
CONFIG_BOOTLOADER_LOG_LEVEL_WARN=y
CONFIG_LOG_DEFAULT_LEVEL_INFO=y
CONFIG_ESP_TASK_WDT_CHECK_IDLE_TASK_CPU0=n
CONFIG_ESP_TASK_WDT_CHECK_IDLE_TASK_CPU1=n
CONFIG_FREERTOS_HZ=1000
# release builds: no build paths or dates in the image, the same image from the same source
CONFIG_APP_REPRODUCIBLE_BUILD=y
CONFIG_PARTITION_TABLE_CUSTOM=y
CONFIG_PARTITION_TABLE_CUSTOM_FILENAME="partitions.csv"
CONFIG_BOOTLOADER_APP_ROLLBACK_ENABLE=y
CONFIG_ESP_DEFAULT_CPU_FREQ_MHZ_240=y
CONFIG_SPIRAM=y
CONFIG_SPIRAM_MODE_OCT=y
CONFIG_SPIRAM_SPEED_80M=y
CONFIG_LWIP_MAX_SOCKETS=16
CONFIG_MBEDTLS_EXTERNAL_MEM_ALLOC=y
CONFIG_SPIRAM_TRY_ALLOCATE_WIFI_LWIP=y
CONFIG_SPIRAM_MALLOC_ALWAYSINTERNAL=2048
CONFIG_COMPILER_OPTIMIZATION_PERF=y
CONFIG_HTTPD_MAX_REQ_HDR_LEN=1024
# LVGL
CONFIG_LV_COLOR_DEPTH_16=y
CONFIG_LV_USE_TINY_TTF=y
CONFIG_LV_TINY_TTF_CACHE_GLYPH_CNT=256
CONFIG_LV_FONT_MONTSERRAT_14=y
CONFIG_LV_FONT_MONTSERRAT_20=y
CONFIG_LV_FONT_MONTSERRAT_28=y
CONFIG_LV_USE_CUSTOM_MALLOC=y
CONFIG_LV_USE_CLIB_STRING=y
CONFIG_LV_USE_CLIB_SPRINTF=y
CONFIG_LV_USE_OBSERVER=n
CONFIG_LV_USE_SNAPSHOT=y
CONFIG_LV_USE_QRCODE=y
CONFIG_SPIRAM_ALLOW_BSS_SEG_EXTERNAL_MEMORY=y
CONFIG_ESP_H264_DECODER_IRAM=y
# streaming bursts fill WiFi's dynamic RX buffers (1.6 KB each, internal RAM)
CONFIG_ESP_WIFI_DYNAMIC_RX_BUFFER_NUM=16
CONFIG_PM_ENABLE=y
# LVGL's bundled examples and demos: not used, only build time
CONFIG_LV_BUILD_EXAMPLES=n
CONFIG_LV_BUILD_DEMOS=n
CONFIG_FREERTOS_USE_TRACE_FACILITY=y
CONFIG_FREERTOS_GENERATE_RUN_TIME_STATS=y
```
